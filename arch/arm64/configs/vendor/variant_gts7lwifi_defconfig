## arch/arm64/configs/vendor/variant_gts7lwifi_defconfig
```kconfig
#
# Kernel Performance Events And Counters
#
# CONFIG_SEC_X1Q_PROJECT is not set
CONFIG_SEC_GTS7L_PROJECT=y

#
# Samsung X/Y/Z/7l
#
# CONFIG_MACH_X1Q_CHN_OPEN is not set
# CONFIG_MACH_GTS7L_EUR_OPEN is not set
CONFIG_MACH_GTS7LWIFI_EUR_OPEN=y
# CONFIG_MACH_GTS7L_KOR_OPEN is not set
# CONFIG_MACH_GTS7L_USA_SINGLE is not set

#
# Control Flow Protection
#
CONFIG_BUILD_ARM64_DT_OVERLAY=y

#
# Memory Management options
#
# CONFIG_TRANSPARENT_HUGEPAGE is not set
CONFIG_PROCESS_RECLAIM_IGNORE_ALL_TYPE=y
CONFIG_MMAP_READAROUND_LIMIT=16
# CONFIG_KZEROD is not set

#
# SEC Memory Management Options
#
CONFIG_COMPAT_NETLINK_MESSAGES=y

#
# Bluetooth device drivers
#
CONFIG_MSM_BT_POWER=y
CONFIG_BTFM_SLIM=y
CONFIG_BT_SLIM_QCA6390=y
# CONFIG_BT_BCM4361 is not set
# CONFIG_BT_BLUESLEEP is not set
CONFIG_WIRELESS_EXT=y
CONFIG_WEXT_CORE=y
CONFIG_WEXT_PROC=y
CONFIG_WEXT_SPY=y
CONFIG_WEXT_PRIV=y
# CONFIG_CFG80211_REG_NOT_UPDATED is not set
# CONFIG_SAMSUNG_NFC is not set
# CONFIG_NFC_PN547 is not set
# CONFIG_NFC_PN547_ESE_SUPPORT is not set
# CONFIG_NFC_FEATURE_SN100U is not set
CONFIG_ESE_SECURE_GPIO=-1
# CONFIG_SEC_NFC_LOGGER is not set

#
# Bus devices
#
# CONFIG_MHI_DEBUG is not set

#
# MHI device support
#
CONFIG_GPS_BCMxxxxx=y
CONFIG_GPS_BCM4753=y
CONFIG_OF_SLIMBUS=y

#
# MII PHY device drivers
#
# CONFIG_WLAN_VENDOR_BROADCOM is not set
# CONFIG_BROADCOM_WIFI is not set
# CONFIG_BCM4375 is not set
# CONFIG_WLAN_BCM4375_ADVANCED_FEATURES is not set

#
# Qualcomm Atheros CLD WLAN module
#
CONFIG_QCA_CLD_WLAN=y
# CONFIG_QCACLD_WLAN_LFR3 is not set
# CONFIG_PRIMA_WLAN_OKC is not set
# CONFIG_WLAN_FEATURE_11W is not set
# CONFIG_WLAN_FEATURE_LPSS is not set
# CONFIG_QCOM_VOWIFI_11R is not set
# CONFIG_QCACLD_FEATURE_NAN is not set
# CONFIG_QCACLD_FEATURE_GREEN_AP is not set
# CONFIG_HELIUMPLUS is not set
# CONFIG_QCOM_TDLS is not set
# CONFIG_QCOM_LTE_COEX is not set
# CONFIG_MPC_UT_FRAMEWORK is not set
# CONFIG_WLAN_OFFLOAD_PACKETS is not set
# CONFIG_WLAN_FASTPATH is not set
# CONFIG_WLAN_NAPI is not set
# CONFIG_WLAN_TX_FLOW_CONTROL_V2 is not set
# CONFIG_WLAN_SYNC_TSF is not set
# CONFIG_LFR_SUBNET_DETECTION is not set
# CONFIG_MCC_TO_SCC_SWITCH is not set
# CONFIG_QCACLD_WLAN_LFR2 is not set
# CONFIG_WLAN_FEATURE_DISA is not set
# CONFIG_WLAN_FEATURE_FIPS is not set
# CONFIG_WLAN_FEATURE_11AX is not set
# CONFIG_ICMP_DISABLE_PS is not set
# CONFIG_BUILD_TIMESTAMP is not set
# CONFIG_WLAN_FEATURE_FILS is not set
# CONFIG_NAN_CONVERGENCE is not set
# CONFIG_WLAN_OBJMGR_DEBUG is not set
# CONFIG_WLAN_FEATURE_DFS_OFFLOAD is not set
# CONFIG_WLAN_FEATURE_SARV1_TO_SARV2 is not set
CONFIG_WCNSS_MEM_PRE_ALLOC=y
CONFIG_CLD_LL_CORE=y
CONFIG_CNSS2=y
# CONFIG_CNSS2_DEBUG is not set
CONFIG_CNSS2_QMI=y
CONFIG_CNSS_ASYNC=y
CONFIG_SEC_SEPARATE_BDFILE=y
CONFIG_BUS_AUTO_SUSPEND=y
CONFIG_CNSS_QCA6390=y
CONFIG_CNSS_UTILS=y
CONFIG_CNSS_QMI_SVC=y
CONFIG_CNSS_GENL=y

#
# Input device support
#
CONFIG_INPUT_MATRIXKMAP=y

#
# Userland interfaces
#
# CONFIG_INPUT_SEC_SECURE_TOUCH is not set

#
# Input Device Drivers
#
# CONFIG_CERTIFY_HALL is not set
CONFIG_LOGICAL_HALL=y
CONFIG_WACOM_HALL=y
CONFIG_WACOM_HALL_SUPPORT_COVER_DETECT=y
CONFIG_KEYBOARD_STM32_POGO=y
# CONFIG_TOUCHSCREEN_SEC_TS_Y79A is not set
CONFIG_TOUCHSCREEN_NOVATEK_NT36523=y
CONFIG_INPUT_WACOM=y
CONFIG_EPEN_WACOM_W9021=y

#
# Qualcomm Technologies, Inc. Demux device config
#
# CONFIG_SAMSUNG_OIS_MCU_STM32 is not set
# CONFIG_SAMSUNG_SBI is not set
CONFIG_SAMSUNG_REAR_DUAL=y
# CONFIG_SAMSUNG_REAR_TRIPLE is not set
# CONFIG_CAMERA_ADAPTIVE_MIPI is not set
# CONFIG_USE_CAMERA_HW_BIG_DATA is not set
# CONFIG_CAMERA_SSM_I2C_ENV is not set
CONFIG_LEDS_PMIC_QPNP=y
CONFIG_SAMSUNG_ACTUATOR_SOFTLANDING=y

#
# AMD Library routines
#
# CONFIG_PANEL_S6E3HA9_AMB611WE01_WQHD is not set
# CONFIG_PANEL_S6E3HA9_AMB644WF01_WQHD is not set
# CONFIG_PANEL_S6E3HAB_AMB623TS01_WQHD is not set
CONFIG_PANEL_NT36523_PPA957DB1_WQXGA=y

#
# CODEC drivers
#
CONFIG_SND_SOC_CS35L41_4SPK=y

#
# LED driver for blink(1) USB RGB LED is under Special HID drivers (HID_THINGM)
#
# CONFIG_LEDS_S2MPB02 is not set

#
# Android
#
CONFIG_ION_RBIN_HEAP_EXCEPTION=y

#
# Qualcomm SoC drivers
#
CONFIG_DSP_SLEEP_RECOVERY=y
# CONFIG_DSP_SLEEP_RECOVERY_FOR_ADSP is not set

#
# HW tracing support
#
CONFIG_SLIMBUS=y
# CONFIG_SLIMBUS_MSM_CTRL is not set
CONFIG_SLIMBUS_MSM_NGD=y
# CONFIG_WIRELESS_AUTH is not set
# CONFIG_PD_CHARGER_HV_DISABLE is not set
# CONFIG_WIRELESS_CHARGER_MFC is not set
# CONFIG_WIRELESS_CHARGER_HAL_MFC is not set
# CONFIG_WIRELESS_IC_PARAM is not set
# CONFIG_WIRELESS_FIRMWARE_UPDATE is not set
# CONFIG_WIRELESS_TX_MODE is not set
CONFIG_TABLET_MODEL_CONCEPT=y
# CONFIG_DISABLE_MFC_IC is not set
# CONFIG_SENSORS_SX9360 is not set
CONFIG_SENSORS_A96T3X6=y
CONFIG_SENSORS_A96T3X6_2CH=y
CONFIG_SENSORS_A96T3X6_WIFI=y
CONFIG_SENSORS_A96T3X6_WIFI_2CH=y
CONFIG_SENSORS_A96T3X6_BLOCK_SAR_ONLY=y
CONFIG_SENSORS_A96T3X6_UNSUPPORT_OTG=y
# CONFIG_SENSORS_TCS3407 is not set

#
# Samsung Debugging Feature
#
# CONFIG_SEC_CP_SEPARATE_DEBUG is not set

#
# Samsung Vbus Notifier drivers
#
# CONFIG_LPS22HH_FACTORY is not set
# CONFIG_TMD490X_FACTORY is not set
# CONFIG_SUPPORT_BRIGHTNESS_NOTIFY_FOR_LIGHT_SENSOR is not set
# CONFIG_SUPPORT_DDI_COPR_FOR_LIGHT_SENSOR is not set
# CONFIG_SUPPORT_UNDER_PANEL_WITH_LIGHT_SENSOR is not set
CONFIG_SUPPORT_DUAL_OPTIC=y
CONFIG_SUPPORT_VIRTUAL_OPTIC=y
CONFIG_VEML3235_FACTORY=y
CONFIG_VEML3235_SUB_FACTORY=y

#
# Redriver IC driver configs
#
CONFIG_REDRIVER=y
# CONFIG_COMBO_REDRIVER_PTN36502 is not set
CONFIG_COMBO_REDRIVER_PS5169=y
# CONFIG_SUPPORT_PS5169_ADBTUNE is not set

#
# Motor configs
#
# CONFIG_ANDROID_TIMED_OUTPUT is not set
CONFIG_MSM_VIBRATOR=y
# CONFIG_SENSORS_QBT2000 is not set
CONFIG_SENSORS_GW3X=y
CONFIG_FIVE_SIGNCLIENT_PATH="/home/dpi/qb5_8814/workspace/P4_1716/buildscript/tools/signclient.jar"
CONFIG_FIVE_PILSPLITTER_PATH="/home/dpi/qb5_8814/workspace/P4_1716/buildscript/tools/pil_splitter.py"

#
# Qualcomm Technologies, Inc Per File Encryption security device drivers
#
# CONFIG_SECURITY_DEFEX is not set
# CONFIG_DEFEX_KERNEL_ONLY is not set
# CONFIG_SECURITY_DSMS is not set
# CONFIG_FIVE is not set
# CONFIG_FIVE_CERT_USER is not set
# CONFIG_FIVE_DEFAULT_HASH_SHA1 is not set
# CONFIG_FIVE_CERT_USER is not set
# CONFIG_FIVE_DEFAULT_HASH_SHA1 is not set
# CONFIG_FIVE_DEFAULT_HASH is not set
# CONFIG_FIVE_TRUSTED_KEYRING is not set
# CONFIG_PROCA is not set
# CONFIG_GAF is not set
# CONFIG_GAF_V6 is not set
```
